## boards/shields/explorerblankv2/Kconfig.defconfig
```kconfig
if SHIELD_EXPLORERBLANKV2_LEFT

# Name must be less than 16 characters long!
config ZMK_KEYBOARD_NAME
    default "EXPLORERBLANKV2"

config ZMK_SPLIT_ROLE_CENTRAL
    default y

endif

if SHIELD_EXPLORERBLANKV2_LEFT || SHIELD_EXPLORERBLANKV2_RIGHT

config ZMK_SPLIT
    default y

endif
```

## boards/shields/explorerblankv2/Kconfig.shield
```kconfig
config SHIELD_EXPLORERBLANKV2_LEFT
    def_bool $(shields_list_contains,explorerblankv2_left)
  
config SHIELD_EXPLORERBLANKV2_RIGHT
    def_bool $(shields_list_contains,explorerblankv2_right)
  
```
